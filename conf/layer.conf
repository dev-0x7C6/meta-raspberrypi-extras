## conf/layer.conf
```bitbake
# We have a conf and classes directory, append to BBPATH
BBPATH .= ":${LAYERDIR}"

# We have a recipes directory, add to BBFILES
BBFILES += " \
	${LAYERDIR}/recipes*/*/*.bb \
	${LAYERDIR}/recipes*/*/*.bbappend \
"

BBFILE_COLLECTIONS += "meta-raspberrypi-extras"
BBFILE_PATTERN_meta-raspberrypi-extras := "^${LAYERDIR}/"
BBFILE_PRIORITY_meta-raspberrypi-extras = "100"

LAYERSERIES_COMPAT_meta-raspberrypi-extras = "dunfell gatesgarth hardknott honister kirkstone langdale"

LAYERDEPENDS_meta-raspberrypi-extras = "raspberrypi"
```
